## drivers/input/misc/oppo_fp_drivers/Kconfig
```kconfig
# SPDX-License-Identifier: GPL-2.0-only
config OPPO_FINGERPRINT
	bool "OPPO fingerprint driver"
	depends on OPPO_COMMON_SOFT && OF && GPIOLIB && INPUT
	depends on REGULATOR && PROC_FS && FB=y
	help
	  Say Y here to enable OPPO fingerprint support for SDM660 devices.
```

## drivers/input/touchscreen/oppo_touchscreen/Synaptics/Kconfig
```kconfig
source "drivers/input/touchscreen/oppo_touchscreen/Synaptics/S3508/Kconfig"
source "drivers/input/touchscreen/oppo_touchscreen/Synaptics/S3320/Kconfig"
```

## drivers/platform/oppo/Kconfig
```kconfig
config MACH_OPPO
	bool "OPPO device"
	depends on ARCH_QCOM
	help
	  Support for OPPO products

config MACH_OPPO_SDM660
	bool "OPPO SDM660"
	depends on ARCH_SDM660
	select MACH_OPPO
	help
	  Support for OPPO SDM660 devices

menu "OPPO board selection"
	depends on ARCH_SDM660

	config MACH_OPPO_R11
		bool "OPPO 16051 board"
		select MACH_OPPO_SDM660
		help
		  Support for OPPO R11, OPPO R11 Plus, OPPO R11 Plusk

	config MACH_OPPO_R11S
		bool "OPPO 17011 board"
		select MACH_OPPO_SDM660
		help
		  Support for OPPO R11s, OPPO R11s Plus

endmenu
```

## drivers/soc/oppo/Kconfig
```kconfig
# SPDX-License-Identifier: GPL-2.0
config OPPO_ARCH_FILE
	bool

source "drivers/soc/oppo/oppo_project/Kconfig"

source "drivers/soc/oppo/oppo_devinfo/Kconfig"
```

## drivers/soc/oppo/oppo_devinfo/Kconfig
```kconfig
# SPDX-License-Identifier: GPL-2.0
config OPPO_DEVICE_INFO
	bool "OPPO device information"
	depends on OPPO_COMMON_SOFT
	depends on OF && GPIOLIB && PINCTRL
	help
	  Expose board and device information in /proc/devinfo.
```

## drivers/soc/oppo/oppo_project/Kconfig
```kconfig
# SPDX-License-Identifier: GPL-2.0
config OPPO_COMMON_SOFT
	bool "OPPO project information"
	depends on ARCH_SDM660
	depends on QCOM_SMEM=y
	depends on PROC_FS && SYSFS
	select OPPO_ARCH_FILE
	help
	  Read project and hardware information from Qualcomm SMEM.
```
